#include <behaviors.dtsi>
#include <dt-bindings/zmk/keys.h>
#include <dt-bindings/zmk/mouse.h>

/ {
    keymap {
        compatible = "zmk,keymap";
        default_layer {
            bindings = <&kp A>;
            sensor-bindings = <&inc_dec_kp PG_UP PG_DN>; // エンコーダー動作確認用 
        };
    };
};